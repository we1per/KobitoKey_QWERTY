## config/west.yml
```yaml
manifest:
  remotes:
    - name: zmkfirmware
      url-base: https://github.com/zmkfirmware
    - name: cormoran
      url-base: https://github.com/cormoran
    - name: badjeff
      url-base: https://github.com/badjeff
    - name: hsgw
      url-base: https://github.com/hsgw
    - name: caksoylar
      url-base: https://github.com/caksoylar

  projects:
    # DYA Studio custom RPC support (main+custom-studio-protocol).
    - name: zmk
      remote: cormoran
      revision: 1fc72aaff7a42bd533c1f4c9b3f23c5317c745f4
      import: app/west.yml

    # Zephyr 4 compatible driver and existing trackball processors.
    - name: zmk-pmw3610-driver
      remote: badjeff
      revision: e970029b42f33613ca8f05baf311dc733cd5a390
    - name: zmk-feature-sensor_rotation
      remote: hsgw
      revision: e1a0186220ade99220d04dadf9735b758cfdf086
    - name: zmk-rgbled-widget
      remote: caksoylar
      revision: e6b467792a1dabef8cfa5c9fd26bfefc9c16662b

    - name: zmk-feature-custom-settings
      remote: cormoran
      revision: c6a7fef3a3be3d3ace5de9a4b0628c6418cd1f3f
      import: true
    - name: zmk-feature-runtime-macro
      remote: cormoran
      revision: 38530962eb7061b60efcb98e84585cfb1f0cb6de
      import: true
    - name: zmk-feature-runtime-combo
      remote: cormoran
      revision: d9490e7b5d41c516221d131241009e81740efcee
      import: true
    - name: zmk-module-runtime-input-processor
      remote: cormoran
      revision: decf628d7ce5ed95b520c650824c28ea9de649c1
      import: true

  self:
    path: config
```

## pointing/Kconfig
```kconfig
config KOBITOKEY_POINTING
    bool "KobitoKey Studio pointing and automatic mouse support"
    depends on ZMK_POINTING && ZMK_SPLIT_ROLE_CENTRAL
    select ZMK_CUSTOM_SETTINGS
    select ZMK_CUSTOM_SETTINGS_STUDIO_RPC

config KOBITOKEY_ALT_TAB
    bool "KobitoKey held Alt-Tab combo behavior"
    depends on ZMK_RUNTIME_COMBO && ZMK_SPLIT_ROLE_CENTRAL
```

## pointing/dts/bindings/behaviors/kobito,alt-tab.yaml
```yaml
description: Hold Alt for a combo, tap Tab on activation, navigate with F and S
compatible: "kobito,alt-tab"
include: zero_param.yaml
```

## pointing/dts/bindings/behaviors/kobito,precision.yaml
```yaml
description: Hold to divide the current pointer speed without changing rotation
compatible: "kobito,precision"
include: zero_param.yaml
```

## pointing/dts/bindings/input_processors/kobito,auto-mouse.yaml
```yaml
description: KobitoKey position-based automatic mouse layer with separate click timeout
compatible: "kobito,auto-mouse"
include: base.yaml
properties:
  track-remainders:
    type: boolean
  "#input-processor-cells":
    type: int
    const: 0
  layer:
    type: int
    required: true
  excluded-positions:
    type: array
    required: true
```
